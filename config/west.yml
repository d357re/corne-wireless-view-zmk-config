## config/west.yml
```yaml
manifest:
  remotes:
    - name: d357re
      url-base: https://github.com/d357re
  projects:
    - name: zmk
      remote: d357re
      revision: d357re-patch-2
      import: app/west.yml
  self:
    path: config
```
